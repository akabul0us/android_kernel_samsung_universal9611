## drivers/net/wireless/realtek/Kconfig.rej
```kconfig
--- drivers/net/wireless/realtek/Kconfig
+++ drivers/net/wireless/realtek/Kconfig
@@ -15,5 +15,6 @@ source "drivers/net/wireless/realtek/rtl818x/Kconfig"
 source "drivers/net/wireless/realtek/rtlwifi/Kconfig"
 source "drivers/net/wireless/realtek/rtl8xxxu/Kconfig"
 source "drivers/net/wireless/realtek/rtl8812au/Kconfig"
+source "drivers/net/wireless/realtek/rtw88/Kconfig"
 
 endif # WLAN_VENDOR_REALTEK
```
